## main/Kconfig.projbuild
```kconfig
menu "P4 Host 无线配置"

    # 键名与 tools/p4_tool.py 一致：图形工具会改写 sdkconfig.defaults 里的这两项
    config ESP_WIFI_SSID
        string "WiFi SSID（热点名称）"
        default "myssid"
        help
            要连接的热点名称，仅支持 ASCII。
            图形工具（p4_tool.py）的“WiFi 配置”写入的就是这里的值。

    config ESP_WIFI_PASSWORD
        string "WiFi Password（密码）"
        default "mypassword"
        help
            WPA/WPA2 密码，至少 8 位。

    config ESP_MAXIMUM_RETRY
        int "Diagnostic scan interval（每失败多少次扫描一次）"
        default 5
        help
            连接失败时，每隔多少次尝试打印一次附近热点扫描结果，
            用于排查 SSID 写错 / 热点没开 / 频段不匹配。设为 0 表示不扫描。

endmenu
```

## p4_host/main/Kconfig.projbuild
```kconfig
menu "P4 Host OTA Configuration"

    config ESP_WIFI_SSID
        string "WiFi SSID"
        default "myssid"
        help
            SSID (network name) for the host to connect to.

    config ESP_WIFI_PASSWORD
        string "WiFi Password"
        default "mypassword"
        help
            WiFi password (WPA/WPA2) for the host to use.

    config ESP_MAXIMUM_RETRY
        int "Maximum retry"
        default 5
        help
            Maximum connection retries before giving up.

    config OTA_SERVER_URL
        string "OTA firmware URL"
        default "https://192.168.1.100:8443/firmware.bin"
        help
            HTTPS URL of the P4 firmware image to download and flash.

    config OTA_HTTPS_TIMEOUT_MS
        int "HTTPS timeout (ms)"
        default 30000
        range 5000 120000
        help
            Connection/SSL handshake timeout for the OTA download.

endmenu
```

## wifi_ota_component/Kconfig
```kconfig
menu "WiFi OTA Helper (无线下载模块)"

    config WIFI_OTA_SSID
        string "WiFi SSID（路由器名称）"
        default "REDMI Turbo 4"
        help
            要连接的 WiFi 名称。必须是英文（ASCII），不支持中文。

    config WIFI_OTA_PASSWORD
        string "WiFi Password（密码）"
        default "11111111"
        help
            WiFi 密码。

    config WIFI_OTA_MAX_RETRY
        int "Maximum WiFi connection retry（最大重连次数）"
        default 5
        help
            WiFi 连接失败时的最大重试次数。

    config WIFI_OTA_TCP_PORT
        int "OTA TCP port（OTA 命令监听端口）"
        default 3333
        help
            电脑端通过此 TCP 端口发送 "ota <固件URL>" 命令触发无线升级。

endmenu
```
